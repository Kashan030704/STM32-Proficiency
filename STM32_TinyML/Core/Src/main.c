/* USER CODE BEGIN Header */
/**
  ******************************************************************************
  * @file           : main.c
  * @brief          : MQ-3 TinyML Anomaly Detector — FreeRTOS
  *
  * Target : STM32F411 (HSI @ 100 MHz)
  * Pins   : PA0 → AO (analog in, ADC1 CH0)
  *          PA8 → DO (digital in, MQ-3 onboard comparator output)
  * Serial : USART2, 115200 8N1
  *
  * AI model : mq3_autoencoder — INT8 quantised, generated by X-Cube-AI
  *   Input  : 8 × float32
  *   Output : 8 × float32 (dequantised)
  *
  * Serial output format:  ADC:<raw>  MSE:<value>  AI:<OK|ANOMALY>  DO:<LOW|HIGH>
  *
  * Threshold calibration:
  *   ANOMALY_THRESHOLD starts at 0.01f.  Watch MSE in clean air ~1 min,
  *   then set to ~3x the highest clean-air MSE you observe.
  ******************************************************************************
  */
/* USER CODE END Header */

/* Includes ------------------------------------------------------------------*/
#include "main.h"
#include "cmsis_os.h"

/* Private includes ----------------------------------------------------------*/
/* USER CODE BEGIN Includes */
#include "ai_platform.h"
#include "network.h"
#include "network_data.h"
#include <stdio.h>
#include <string.h>
/* USER CODE END Includes */

/* Private typedef -----------------------------------------------------------*/
/* USER CODE BEGIN PTD */
/* USER CODE END PTD */

/* Private define ------------------------------------------------------------*/
/* USER CODE BEGIN PD */
/* USER CODE END PD */

/* Private macro -------------------------------------------------------------*/
/* USER CODE BEGIN PM */
/* USER CODE END PM */

/* Private variables ---------------------------------------------------------*/
ADC_HandleTypeDef hadc1;
TIM_HandleTypeDef htim2;
UART_HandleTypeDef huart2;

/* Definitions for defaultTask */
osThreadId_t defaultTaskHandle;
const osThreadAttr_t defaultTask_attributes = {
  .name       = "defaultTask",
  .stack_size = 512 * 4,          /* 2 KB — needed for floats + snprintf    */
  .priority   = (osPriority_t) osPriorityNormal,
};

/* USER CODE BEGIN PV */

/* ── Anomaly threshold ───────────────────────────────────────────────────────
 * Start at 0.01f.  Watch the MSE column in clean air for ~1 minute, then
 * set this to ~3x the highest clean-air MSE you observe.               */
#define ANOMALY_THRESHOLD   0.01f

#define ADC_MAX             4095.0f
#define WINDOW_SIZE         8       /* must match model input size            */

/* Circular ADC sample buffer */
static uint16_t adc_buf[WINDOW_SIZE] = {0};
static uint32_t buf_head  = 0;
static uint8_t  buf_ready = 0;

/* ── X-Cube-AI ───────────────────────────────────────────────────────────── */
static ai_handle network = AI_HANDLE_NULL;
static ai_u8 activations[AI_NETWORK_DATA_ACTIVATIONS_SIZE] __attribute__((aligned(4)));
static const ai_handle activation_buffers[] = { activations };

/* USER CODE END PV */

/* Private function prototypes -----------------------------------------------*/
void SystemClock_Config(void);
static void MX_GPIO_Init(void);
static void MX_TIM2_Init(void);
static void MX_USART2_UART_Init(void);
static void MX_ADC1_Init(void);
void StartDefaultTask(void *argument);

/* USER CODE BEGIN PFP */
/* USER CODE END PFP */

/* Private user code ---------------------------------------------------------*/
/* USER CODE BEGIN 0 */
/* USER CODE END 0 */

/**
  * @brief  The application entry point.
  * @retval int
  */
int main(void)
{
  /* USER CODE BEGIN 1 */
  /* USER CODE END 1 */

  HAL_Init();

  /* USER CODE BEGIN Init */
  /* USER CODE END Init */

  SystemClock_Config();

  /* USER CODE BEGIN SysInit */
  /* USER CODE END SysInit */

  MX_GPIO_Init();
  MX_TIM2_Init();
  MX_USART2_UART_Init();
  MX_ADC1_Init();

  /* USER CODE BEGIN 2 */

  /* Initialise AI network — weights live in Flash, passed as NULL */
  {
    ai_error err = ai_network_create_and_init(&network, activation_buffers, NULL);
    if (err.type != AI_ERROR_NONE)
      Error_Handler();
  }

  /* Startup banner — sent before the scheduler starts */
  {
    const char *boot_msg =
        "\r\n=== MQ-3 TinyML Anomaly Detector (FreeRTOS) ===\r\n"
        "Filling sample buffer...\r\n";
    HAL_UART_Transmit(&huart2, (uint8_t *)boot_msg, strlen(boot_msg), HAL_MAX_DELAY);
  }

  /* USER CODE END 2 */

  /* Init scheduler */
  osKernelInitialize();

  /* USER CODE BEGIN RTOS_MUTEX */
  /* USER CODE END RTOS_MUTEX */

  /* USER CODE BEGIN RTOS_SEMAPHORES */
  /* USER CODE END RTOS_SEMAPHORES */

  /* USER CODE BEGIN RTOS_TIMERS */
  /* USER CODE END RTOS_TIMERS */

  /* USER CODE BEGIN RTOS_QUEUES */
  /* USER CODE END RTOS_QUEUES */

  defaultTaskHandle = osThreadNew(StartDefaultTask, NULL, &defaultTask_attributes);

  /* USER CODE BEGIN RTOS_THREADS */
  /* USER CODE END RTOS_THREADS */

  /* USER CODE BEGIN RTOS_EVENTS */
  /* USER CODE END RTOS_EVENTS */

  osKernelStart();

  /* Should never reach here */
  while (1) {}
}

/**
  * @brief System Clock Configuration
  */
void SystemClock_Config(void)
{
  RCC_OscInitTypeDef RCC_OscInitStruct = {0};
  RCC_ClkInitTypeDef RCC_ClkInitStruct = {0};

  __HAL_RCC_PWR_CLK_ENABLE();
  __HAL_PWR_VOLTAGESCALING_CONFIG(PWR_REGULATOR_VOLTAGE_SCALE1);

  RCC_OscInitStruct.OscillatorType      = RCC_OSCILLATORTYPE_HSI;
  RCC_OscInitStruct.HSIState            = RCC_HSI_ON;
  RCC_OscInitStruct.HSICalibrationValue = RCC_HSICALIBRATION_DEFAULT;
  RCC_OscInitStruct.PLL.PLLState        = RCC_PLL_ON;
  RCC_OscInitStruct.PLL.PLLSource       = RCC_PLLSOURCE_HSI;
  RCC_OscInitStruct.PLL.PLLM            = 8;
  RCC_OscInitStruct.PLL.PLLN            = 100;
  RCC_OscInitStruct.PLL.PLLP            = RCC_PLLP_DIV2;
  RCC_OscInitStruct.PLL.PLLQ            = 7;
  if (HAL_RCC_OscConfig(&RCC_OscInitStruct) != HAL_OK) Error_Handler();

  RCC_ClkInitStruct.ClockType      = RCC_CLOCKTYPE_HCLK | RCC_CLOCKTYPE_SYSCLK
                                   | RCC_CLOCKTYPE_PCLK1 | RCC_CLOCKTYPE_PCLK2;
  RCC_ClkInitStruct.SYSCLKSource   = RCC_SYSCLKSOURCE_PLLCLK;
  RCC_ClkInitStruct.AHBCLKDivider  = RCC_SYSCLK_DIV1;
  RCC_ClkInitStruct.APB1CLKDivider = RCC_HCLK_DIV2;
  RCC_ClkInitStruct.APB2CLKDivider = RCC_HCLK_DIV1;
  if (HAL_RCC_ClockConfig(&RCC_ClkInitStruct, FLASH_LATENCY_3) != HAL_OK) Error_Handler();
}

/**
  * @brief ADC1 Initialization Function
  */
static void MX_ADC1_Init(void)
{
  /* USER CODE BEGIN ADC1_Init 0 */
  /* USER CODE END ADC1_Init 0 */

  ADC_ChannelConfTypeDef sConfig = {0};

  /* USER CODE BEGIN ADC1_Init 1 */
  /* USER CODE END ADC1_Init 1 */

  hadc1.Instance                   = ADC1;
  hadc1.Init.ClockPrescaler        = ADC_CLOCK_SYNC_PCLK_DIV4;
  hadc1.Init.Resolution            = ADC_RESOLUTION_12B;
  hadc1.Init.ScanConvMode          = DISABLE;
  hadc1.Init.ContinuousConvMode    = DISABLE;
  hadc1.Init.DiscontinuousConvMode = DISABLE;
  hadc1.Init.ExternalTrigConvEdge  = ADC_EXTERNALTRIGCONVEDGE_NONE;
  hadc1.Init.ExternalTrigConv      = ADC_SOFTWARE_START;
  hadc1.Init.DataAlign             = ADC_DATAALIGN_RIGHT;
  hadc1.Init.NbrOfConversion       = 1;
  hadc1.Init.DMAContinuousRequests = DISABLE;
  hadc1.Init.EOCSelection          = ADC_EOC_SINGLE_CONV;
  if (HAL_ADC_Init(&hadc1) != HAL_OK) Error_Handler();

  sConfig.Channel      = ADC_CHANNEL_0;
  sConfig.Rank         = 1;
  sConfig.SamplingTime = ADC_SAMPLETIME_3CYCLES;
  if (HAL_ADC_ConfigChannel(&hadc1, &sConfig) != HAL_OK) Error_Handler();

  /* USER CODE BEGIN ADC1_Init 2 */
  /* USER CODE END ADC1_Init 2 */
}

/**
  * @brief TIM2 Initialization Function
  */
static void MX_TIM2_Init(void)
{
  /* USER CODE BEGIN TIM2_Init 0 */
  /* USER CODE END TIM2_Init 0 */

  TIM_ClockConfigTypeDef  sClockSourceConfig = {0};
  TIM_MasterConfigTypeDef sMasterConfig      = {0};

  /* USER CODE BEGIN TIM2_Init 1 */
  /* USER CODE END TIM2_Init 1 */

  htim2.Instance               = TIM2;
  htim2.Init.Prescaler         = 80 - 1;
  htim2.Init.CounterMode       = TIM_COUNTERMODE_UP;
  htim2.Init.Period            = 65536 - 1;
  htim2.Init.ClockDivision     = TIM_CLOCKDIVISION_DIV1;
  htim2.Init.AutoReloadPreload = TIM_AUTORELOAD_PRELOAD_DISABLE;
  if (HAL_TIM_Base_Init(&htim2) != HAL_OK) Error_Handler();

  sClockSourceConfig.ClockSource = TIM_CLOCKSOURCE_INTERNAL;
  if (HAL_TIM_ConfigClockSource(&htim2, &sClockSourceConfig) != HAL_OK) Error_Handler();

  sMasterConfig.MasterOutputTrigger = TIM_TRGO_RESET;
  sMasterConfig.MasterSlaveMode     = TIM_MASTERSLAVEMODE_DISABLE;
  if (HAL_TIMEx_MasterConfigSynchronization(&htim2, &sMasterConfig) != HAL_OK) Error_Handler();

  /* USER CODE BEGIN TIM2_Init 2 */
  /* USER CODE END TIM2_Init 2 */
}

/**
  * @brief USART2 Initialization Function
  */
static void MX_USART2_UART_Init(void)
{
  /* USER CODE BEGIN USART2_Init 0 */
  /* USER CODE END USART2_Init 0 */

  /* USER CODE BEGIN USART2_Init 1 */
  /* USER CODE END USART2_Init 1 */

  huart2.Instance          = USART2;
  huart2.Init.BaudRate     = 115200;
  huart2.Init.WordLength   = UART_WORDLENGTH_8B;
  huart2.Init.StopBits     = UART_STOPBITS_1;
  huart2.Init.Parity       = UART_PARITY_NONE;
  huart2.Init.Mode         = UART_MODE_TX_RX;
  huart2.Init.HwFlowCtl    = UART_HWCONTROL_NONE;
  huart2.Init.OverSampling = UART_OVERSAMPLING_16;
  if (HAL_UART_Init(&huart2) != HAL_OK) Error_Handler();

  /* USER CODE BEGIN USART2_Init 2 */
  /* USER CODE END USART2_Init 2 */
}

/**
  * @brief GPIO Initialization Function
  */
static void MX_GPIO_Init(void)
{
  GPIO_InitTypeDef GPIO_InitStruct = {0};

  /* USER CODE BEGIN MX_GPIO_Init_1 */
  /* USER CODE END MX_GPIO_Init_1 */

  __HAL_RCC_GPIOA_CLK_ENABLE();

  /* PA8 — digital input, reads DO from MQ-3 onboard comparator */
  GPIO_InitStruct.Pin   = D0_Pin;
  GPIO_InitStruct.Mode  = GPIO_MODE_INPUT;
  GPIO_InitStruct.Pull  = GPIO_NOPULL;
  HAL_GPIO_Init(D0_GPIO_Port, &GPIO_InitStruct);

  /* USER CODE BEGIN MX_GPIO_Init_2 */
  /* USER CODE END MX_GPIO_Init_2 */
}

/* USER CODE BEGIN 4 */
/* USER CODE END 4 */

/* USER CODE BEGIN Header_StartDefaultTask */
/**
  * @brief  Main sensor + inference loop, runs as the FreeRTOS default task.
  */
/* USER CODE END Header_StartDefaultTask */
void StartDefaultTask(void *argument)
{
  /* USER CODE BEGIN 5 */
  for (;;)
  {
    /* ── Step 1: Sample ADC into circular buffer ──────────────────────── */
    HAL_ADC_Start(&hadc1);
    HAL_ADC_PollForConversion(&hadc1, HAL_MAX_DELAY);
    adc_buf[buf_head % WINDOW_SIZE] = (uint16_t)HAL_ADC_GetValue(&hadc1);
    buf_head++;

    /* Wait until buffer fully populated to avoid zero-pad MSE */
    if (buf_head < WINDOW_SIZE)
    {
      osDelay(100);
      continue;
    }

    if (!buf_ready)
    {
      buf_ready = 1;
      const char *rdy = "Buffer full — inference active\r\n";
      HAL_UART_Transmit(&huart2, (uint8_t *)rdy, strlen(rdy), HAL_MAX_DELAY);
    }

    /* ── Step 2: Build 8-element feature vector ───────────────────────
     *   [0..3]  last 4 normalised readings, newest first
     *   [4]     window mean
     *   [5]     window max
     *   [6]     window min
     *   [7]     delta = newest - oldest
     * After buf_head++, (buf_head % WINDOW_SIZE) is the OLDEST slot.  */
    float features[WINDOW_SIZE];
    float recon[WINDOW_SIZE];

    features[0] = adc_buf[(buf_head - 1u) % WINDOW_SIZE] / ADC_MAX;
    features[1] = adc_buf[(buf_head - 2u) % WINDOW_SIZE] / ADC_MAX;
    features[2] = adc_buf[(buf_head - 3u) % WINDOW_SIZE] / ADC_MAX;
    features[3] = adc_buf[(buf_head - 4u) % WINDOW_SIZE] / ADC_MAX;

    float sum = 0.0f, mx = 0.0f, mn = 1.0f;
    for (int i = 0; i < WINDOW_SIZE; i++)
    {
      float v = adc_buf[i] / ADC_MAX;
      sum += v;
      if (v > mx) mx = v;
      if (v < mn) mn = v;
    }
    features[4] = sum / (float)WINDOW_SIZE;
    features[5] = mx;
    features[6] = mn;
    features[7] = features[0] - (adc_buf[buf_head % WINDOW_SIZE] / ADC_MAX);

    /* ── Step 3: Run AI inference ─────────────────────────────────────── */
    ai_buffer *ai_input  = ai_network_inputs_get(network, NULL);
    ai_buffer *ai_output = ai_network_outputs_get(network, NULL);
    ai_input->data  = AI_HANDLE_PTR(features);
    ai_output->data = AI_HANDLE_PTR(recon);

    ai_i32 n_batch = ai_network_run(network, ai_input, ai_output);
    if (n_batch <= 0)
    {
      ai_error err = ai_network_get_error(network);
      char errmsg[64];
      int  elen = snprintf(errmsg, sizeof(errmsg),
                           "AI ERR type:%d code:%d\r\n", err.type, err.code);
      HAL_UART_Transmit(&huart2, (uint8_t *)errmsg, (uint16_t)elen, HAL_MAX_DELAY);
      osDelay(100);
      continue;
    }

    /* ── Step 4: Compute MSE reconstruction error ─────────────────────
     * X-Cube-AI dequantises INT8 output to float32, so recon[] is in
     * the same [0,1] space as features[].                              */
    float mse = 0.0f;
    for (int i = 0; i < WINDOW_SIZE; i++)
    {
      float diff = features[i] - recon[i];
      mse += diff * diff;
    }
    mse /= (float)WINDOW_SIZE;

    /* ── Step 5: Read DO pin (PA8) ────────────────────────────────────── */
    GPIO_PinState do_pin = HAL_GPIO_ReadPin(D0_GPIO_Port, D0_Pin);

    /* ── Step 6: UART log ─────────────────────────────────────────────── */
    char msg[96];
    int  len = snprintf(msg, sizeof(msg),
                        "ADC:%4u  MSE:%.6f  AI:%s  DO:%s\r\n",
                        adc_buf[(buf_head - 1u) % WINDOW_SIZE],
                        (double)mse,
                        (mse > ANOMALY_THRESHOLD) ? "ANOMALY" : "OK",
                        (do_pin == GPIO_PIN_SET)   ? "HIGH"    : "LOW");
    HAL_UART_Transmit(&huart2, (uint8_t *)msg, (uint16_t)len, HAL_MAX_DELAY);

    /* ── Step 7: 100 ms sample period ────────────────────────────────── */
    osDelay(100);
  }
  /* USER CODE END 5 */
}

/**
  * @brief  Period elapsed callback — feeds HAL 1 ms tick from TIM1
  */
void HAL_TIM_PeriodElapsedCallback(TIM_HandleTypeDef *htim)
{
  /* USER CODE BEGIN Callback 0 */
  /* USER CODE END Callback 0 */
  if (htim->Instance == TIM1) HAL_IncTick();
  /* USER CODE BEGIN Callback 1 */
  /* USER CODE END Callback 1 */
}

/**
  * @brief  Error handler — disable interrupts and halt
  */
void Error_Handler(void)
{
  /* USER CODE BEGIN Error_Handler_Debug */
  __disable_irq();
  while (1) {}
  /* USER CODE END Error_Handler_Debug */
}

#ifdef USE_FULL_ASSERT
void assert_failed(uint8_t *file, uint32_t line) {}
#endif